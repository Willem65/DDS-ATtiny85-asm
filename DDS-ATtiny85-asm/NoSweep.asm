.DEVICE ATtiny85	;for avrasm

.def temp = r18
.def del = r19
.def vlag = r17

;***************************************************************************
         
.Org	$0000
		rjmp	RESET		; Reset Handler

;--------- BEGIN -----------------------------------------------
RESET:	

        LDI		R16, HIGH(RAMEND)  //Initialized the stack
		OUT		SPH, R16
		LDI		R16, LOW(RAMEND)
		OUT		SPL, R16
		CLR		R16
		rcall wacht
;***************************************************************************
; PLL setup
;***************************************************************************
		ldi 	r16, (1<<PLLE)		; Enable PLL
		out	PLLCSR, r16

waitPLL:
		in	r16, PLLCSR		; Wait for PLL to lock (approx. 100ms)
		sbrs 	r16, PLOCK			
		rjmp 	waitPLL 	
	
		in	r16, PLLCSR		; Set PLL as PWM clock source 
		ldi	r17, (1<<PCKE)
		or	r16, r17
		out	PLLCSR, r16

;***************************************************************************
; Port B setup
;***************************************************************************
		ldi	r16,0b00010100 	; set output
		out	PORTB,r16		; 1 = pull-up , 0 = float
		ldi	r16,0b00011010 	; low 2 bits are output, 1 = output , 0 = input
		out	DDRB,r16       	; to data direction register

		sbi	AcsR,	Acd		; Disable Comparator                     
      			 
	   	sbi	DidR0,	Adc3d		; Disable Adc3d Digital Input
	   	sbi	DidR0,	Adc2d		; Disable Adc2d Digital Input
		
		ldi  	ZH,High(2*SinTab3) 	; Point ZH to Sine Table	

;***************************************************************************
; TIMER_COUNTER_1
; TCCR1 - Timer/Counter Control Register
;.equ	CS10	= 0	; Clock Select Bits
;.equ	CS11	= 1	; Clock Select Bits
;.equ	CS12	= 2	; Clock Select Bits
;.equ	CS13	= 3	; Clock Select Bits
;.equ	COM1A0	= 4	; Compare Output Mode, Bit 1
;.equ	COM1A1	= 5	; Compare Output Mode, Bit 0
;.equ	PWM1A	= 6	; Pulse Width Modulator Enable
;.equ	CTC1	= 7	; Clear Timer/Counter on Compare Match
;***************************************************************************
;T0_start:
		ldi	r16,0b01100001	; PCk  230 kHz
		out	TCCR1,r16		; 

;***************************************************************************
; ; AD-Converter setup:
;***************************************************************************						

		ldi		r27, 0b1
		ldi		r26, 0b1000_0000	; 1 KHz
		ldi		vlag, 2

; 16 bit DDS			; @ 8 cycles

loop:			
	 	add  	r29, r26	      	; move to phase			
	 	adc  	r30, r27		    ; range 1..2046 
	 	lpm  	r0,z			    ; load program memmory		
		out		OCR1A, r0			; sine wave pwm				
		in		temp, PINB          ; get state of pins on Port B
		andi	temp, 0b0000_0001   ; you should mask to get only what you want
		cpi		temp, 0             ; compare result to 0 (pushbutton is pressed)
		brne	loop                ; if != 0, go check again

knoplow:	
		in		temp, PINB           ; get state of pins on Port B
		andi	temp, 0b0000_0001    ; you should mask to get only what you want
		cpi		temp, 0              ; compare result to 0 (pushbutton is pressed)
		ldi		r16, 0b0000_0000	 ;LED off
		out		PORTB, r16

		breq	knoplow 
		rcall	 wacht
		ldi		r16, 0b0001_0000	 ;LED on
		out		PORTB, r16

		cpi	vlag, 0
		breq	loop2
		cpi	vlag, 1
		breq	loop3
		cpi	vlag, 2
		breq	loop4

loop2:			
		ldi  	ZH,High(2*SinTab2) 	; Point ZH to Sine Table
		in		temp, PINB          ; get state of pins on Port B
		andi	temp, 0b0000_0001   ; you should mask to get only what you want
		cpi		temp, 0             ; compare result to 0 (pushbutton is pressed)
		breq	loop2 
		ldi		r27, 0b0
		ldi		r26, 0b0001_0101	; 60 Hz
		ldi		vlag, 1
		rjmp	loop

loop3:			
		ldi  	ZH,High(2*SinTab3) 	; Point ZH to Sine Table
		in		temp, PINB          ; get state of pins on Port B
		andi	temp, 0b0000_0001   ; you should mask to get only what you want
		cpi		temp, 0             ; compare result to 0 (pushbutton is pressed)
		breq	loop2 
		ldi		r27, 0b1
		ldi		r26, 0b1000_0000	; 1 KHz
		ldi		vlag, 2
		rjmp	loop

loop4:			
		ldi  	ZH,High(2*SinTab) 	; Point ZH to Sine Table
		in		temp, PINB          ; get state of pins on Port B
		andi	temp, 0b0000_0001   ; you should mask to get only what you want
		cpi		temp, 0             ; compare result to 0 (pushbutton is pressed)
		breq	loop2 
		ldi		r27, 0b10000
		ldi		r26, 0b0000_0000    ; 12 KHz
		ldi		vlag, 0
		rjmp	loop



;--------- DELAY LOOP -----------------------------------------------
wacht:
			push r19
			push r20
			push r21

			ldi  r21,0
lus_111:	INC  r21

			ldi  r20,0
lus_122:	INC  r20

			ldi  r19,0
lus_133:	INC  r19
		
			CPI  r19,0x0f	
			BRCS lus_133
			
			CPI  r20,0x1	
			BRCS lus_122

			CPI  r21,0xff	
			BRCS lus_111
			pop r21
			pop r20
			pop r19

			ret

;***************************************************************************
.org    $0100	

	; force table to begin at 256 byte boundary
		
;***************************************************************************
SinTab: 	; 256 step sine wave table  12KHz

.db	0x80,0x83,0x86,0x89,0x8c,0x8f,0x92,0x95,0x98,0x9c,0x9f,0xa2,0xa5,0xa8,0xab,0xae
.db	0xb0,0xb3,0xb6,0xb9,0xbc,0xbf,0xc1,0xc4,0xc7,0xc9,0xcc,0xce,0xd1,0xd3,0xd5,0xd8
.db	0xda,0xdc,0xde,0xe0,0xe2,0xe4,0xe6,0xe8,0xea,0xec,0xed,0xef,0xf0,0xf2,0xf3,0xf5
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.db	0x4f,0x51,0x54,0x57,0x5a,0x5d,0x60,0x63,0x67,0x6a,0x6d,0x70,0x73,0x76,0x79,0x7c

;***************************************************************************
SinTab2: 	; 256 step sine wave table 60 Hz

.db	0x1c,0x1c,0x1d,0x1e,0x1e,0x1f,0x20,0x20,0x21,0x22,0x22,0x23,0x23,0x24,0x25,0x25
.db	0x26,0x27,0x27,0x28,0x28,0x29,0x2a,0x2a,0x2b,0x2b,0x2c,0x2c,0x2d,0x2d,0x2e,0x2e
.db	0x2f,0x2f,0x30,0x30,0x31,0x31,0x32,0x32,0x32,0x33,0x33,0x33,0x34,0x34,0x34,0x35
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.db	0x11,0x12,0x12,0x13,0x14,0x14,0x15,0x15,0x16,0x17,0x17,0x18,0x19,0x19,0x1a,0x1b


;***************************************************************************
SinTab3: 	; 256 step sine wave table 1 KHz

.db	0x19,0x1a,0x1a,0x1b,0x1b,0x1c,0x1d,0x1d,0x1e,0x1e,0x1f,0x20,0x20,0x21,0x21,0x22
.db	0x23,0x23,0x24,0x24,0x25,0x25,0x26,0x26,0x27,0x27,0x28,0x28,0x29,0x29,0x2a,0x2a
.db	0x2b,0x2b,0x2c,0x2c,0x2c,0x2d,0x2d,0x2d,0x2e,0x2e,0x2e,0x2f,0x2f,0x2f,0x30,0x30
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.db	0xf,0x10,0x11,0x11,0x12,0x12,0x13,0x14,0x14,0x15,0x15,0x16,0x17,0x17,0x18,0x18





